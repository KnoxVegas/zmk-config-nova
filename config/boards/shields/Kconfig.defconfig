## config/boards/shields/Kconfig.defconfig
```kconfig
if SHIELD_NOVA_LEFT

# Name must be less than 16 characters long!
config ZMK_KEYBOARD_NAME
    default "Nova"

config ZMK_SPLIT_ROLE_CENTRAL
    default y

endif

if SHIELD_NOVA_LEFT || SHIELD_NOVA_RIGHT

config ZMK_SPLIT
    default y

endif
```

## config/boards/shields/Nova/Kconfig.shield
```kconfig
config SHIELD_NOVA_LEFT
    def_bool $(shields_list_contains,Nova_left)

config SHIELD_NOVA_RIGHT
    def_bool $(shields_list_contains,Nova_right)
```
